## border_router/main/Kconfig.projbuild
```kconfig
menu "Border Router Configuration"

config BR_WIFI_SSID
    string "Backbone WiFi SSID"
    default "myhome"
    help
        SSID of the home/office WiFi network used as the Thread backbone.

config BR_WIFI_PASSWORD
    string "Backbone WiFi Password"
    default ""
    help
        Password for the backbone WiFi network (WPA2-PSK).

config BR_THREAD_NETWORK_NAME
    string "Thread Network Name Prefix"
    default "ESP-Thread"
    help
        Prefix for the auto-generated Thread network name.
        The last two bytes of the board MAC address are appended
        (e.g. "ESP-Thread-A1B2").

config ENABLE_MATTER_CONSOLE
    bool "Enable Matter diagnostic console"
    default y
    help
        Enable the Matter CLI console over UART for diagnostics.

endmenu
```

## matter_thread_device/main/Kconfig.projbuild
```kconfig
menu "Matter Thread Device Configuration"

config MTD_LED_GPIO
    int "LED GPIO number"
    range 0 21
    default 8
    help
        GPIO number for the on/off status LED.
        XIAO ESP32C5 / ESP32C6: connect an LED (with resistor) to this pin.
        Default is GPIO8 – adjust to match your actual wiring.

config MTD_BUTTON_GPIO
    int "Factory-reset button GPIO number"
    range 0 21
    default 9
    help
        GPIO number for the factory-reset button.
        On XIAO boards the BOOT button is on GPIO9 (active-low).
        A long press (> 3 s) erases commissioning data and reboots.

config ENABLE_MATTER_CONSOLE
    bool "Enable Matter diagnostic console"
    default y
    help
        Enable the Matter CLI console over UART.
        Useful during development; can be disabled for production builds.

endmenu
```
